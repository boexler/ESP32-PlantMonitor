## firmware/main/Kconfig.projbuild
```kconfig
menu "Plant Monitor (ESP32-C6)"

    choice PM_POWER_MODE
        prompt "Power / sleep behaviour"
        default PM_POWER_DEEP_SLEEP
        help
            Choose deep sleep between measurement cycles (battery/low power),
            or continuous operation (easier debugging over USB serial: no sleep).

        config PM_POWER_DEEP_SLEEP
            bool "Deep sleep between measurements"

        config PM_POWER_CONTINUOUS_DEBUG
            bool "Continuous (debug, no deep sleep)"

    endchoice

    config PM_MEASURE_INTERVAL_SEC
        int "Deep sleep duration (seconds)"
        depends on PM_POWER_DEEP_SLEEP
        default 3600
        help
            Time spent in deep sleep after each measurement cycle before the next wake.

    config PM_POST_WIFI_MEASURE_WINDOW_SEC
        int "Deep sleep: ADC averaging window before MQTT (seconds)"
        depends on PM_POWER_DEEP_SLEEP
        default 20
        range 0 3600
        help
            After Wi-Fi is up and ADC is initialized, average readings over this many seconds before MQTT publish.
            0 = legacy behaviour (single immediate measurement burst).

    config PM_POST_WIFI_MEASURE_SAMPLE_PERIOD_MS
        int "Deep sleep: delay between averaged batches in measurement window (ms)"
        depends on PM_POWER_DEEP_SLEEP
        default 500
        range 50 10000
        help
            Interval between pm_adc_read_averaged batches while filling the pre-MQTT measurement window.

    config PM_DEBUG_LOOP_PERIOD_MS
        int "Continuous mode delay between cycles (milliseconds)"
        depends on PM_POWER_CONTINUOUS_DEBUG
        default 5000
        help
            Idle delay between repeated measure + MQTT publishes when continuous (debug) mode is selected.

    config ESP_WIFI_SSID
        string "WiFi SSID"
        default "myssid"

    config ESP_WIFI_PASSWORD
        string "WiFi Password"
        default "mypassword"

    choice ESP_WIFI_SCAN_AUTH_MODE_THRESHOLD
        prompt "WiFi Scan auth mode threshold"
        default ESP_WIFI_AUTH_WPA2_PSK
        config ESP_WIFI_AUTH_OPEN
            bool "OPEN"
        config ESP_WIFI_AUTH_WPA2_PSK
            bool "WPA2 PSK"
        config ESP_WIFI_AUTH_WPA3_PSK
            bool "WPA3 PSK"
        config ESP_WIFI_AUTH_WPA2_WPA3_PSK
            bool "WPA2/WPA3 PSK"
    endchoice

    config ESP_MAXIMUM_RETRY
        int "Maximum WiFi connection retries"
        default 5

    choice PM_WIFI_ANTENNA
        prompt "Wi-Fi antenna (XIAO ESP32-C6)"
        default PM_WIFI_ANT_EXTERNAL
        help
            Seeed XIAO ESP32-C6 routes RF through an FM8625H switch controlled by GPIO3 (enable)
            and GPIO14 (path select). See docs/hardware_xiao_esp32c6.md.

        config PM_WIFI_ANT_EXTERNAL
            bool "External (U.FL)"

        config PM_WIFI_ANT_INTERNAL
            bool "Internal (PCB ceramic)"

    endchoice

    config ESP_CONFIG_URL
        string "Device registry JSON URL"
        default "http://homeassistant.local/local/plant_monitor_devices.json"
        help
            HTTPS/HTTP URL returning JSON (see docs). Maps station MAC to name and per-channel active flags.

    config ESP_NTP_TZ
        string "POSIX timezone (TZ)"
        default "CET-1CEST,M3.5.0,M10.5.0/3"

    config ESP_NTP_SERVER
        string "NTP server"
        default "pool.ntp.org"

    config ESP_SYSLOG_SERVER
        string "Syslog server (UDP, empty to disable)"
        default ""

    config PM_MQTT_BROKER_URI
        string "MQTT broker URI"
        default "mqtt://192.168.1.10:1883"
        help
            Example: mqtt://user:pass@host:1883 or mqtts://...

    config PM_MQTT_USERNAME
        string "MQTT username (optional)"
        default ""

    config PM_MQTT_PASSWORD
        string "MQTT password (optional)"
        default ""

    config PM_MQTT_TOPIC_PREFIX
        string "MQTT topic prefix"
        default "plant_monitor"

    config PM_HA_DISCOVERY_PREFIX
        string "Home Assistant MQTT discovery prefix"
        default "homeassistant"

    config PM_ADC_SAMPLE_COUNT
        int "Samples per channel (averaged)"
        default 8

    config PM_SOIL_ADC_DISCONNECT_MAX
        int "Soil ADC: no-sensor threshold (raw strictly below = disconnected)"
        default 1300
        range 0 4095
        help
            No Sensor / Sensor disconnected.
            Averaged raw ADC below this value is treated as no probe connected; moisture is -1 and a warning is logged.

    config PM_SOIL_ADC_WATER
        int "Soil ADC: reference raw for in water (100% moisture)"
        default 2000
        range 0 4095
        help
            Reference: "in Water" (100%).
            Wet endpoint of the linear map: 100% moisture at this raw. Together with the air reference, raw values in between map to 0–100% (clamped). Raw below this (but above the disconnect threshold) clamps to 100%.

    config PM_SOIL_ADC_ILEX_VERY_WET
        int "Soil ADC: reference raw for a very moist plant (documentation / tuning)"
        default 2300
        range 0 4095
        help
            Reference: A very moist plant.
            Not used in the linear moisture formula; stored for calibration notes and menuconfig tuning.

    config PM_SOIL_ADC_VERY_DRY
        int "Soil ADC: reference raw for a very dry plant (documentation / tuning)"
        default 2500
        range 0 4095
        help
            Reference: A very dry plant.
            Not used in the linear moisture formula; stored for calibration notes and menuconfig tuning.

    config PM_SOIL_ADC_AIR
        int "Soil ADC: reference raw for air (0% moisture)"
        default 2600
        range 0 4095
        help
            Reference: Air (0 %).
            Lower end of the linear map: 0% moisture at this raw (higher raw = drier). Must be greater than the water reference.

    config PM_SOIL_ADC_SPIKE_MIN
        int "Soil ADC: no-sensor above this raw (strictly greater; spikes / invalid)"
        default 3000
        range 0 4095
        help
            Averaged raw ADC greater than this value is treated as no probe / invalid (e.g. EMI spikes); moisture is -1 like a disconnected channel.

endmenu
```

## firmware/sdkconfig.defaults
```kconfig
# Seeed XIAO ESP32-C6 (ESP32-C6)
CONFIG_ESPTOOLPY_FLASHMODE_QIO=y
CONFIG_ESPTOOLPY_FLASHSIZE_4MB=y
CONFIG_PARTITION_TABLE_SINGLE_APP_LARGE=y
CONFIG_ESP_MAIN_TASK_STACK_SIZE=8192
CONFIG_ESP_SYSTEM_EVENT_TASK_STACK_SIZE=4096
CONFIG_COMPILER_OPTIMIZATION_SIZE=y

# Default: deep sleep mode (explicit for fresh clones before menuconfig)
CONFIG_PM_POWER_DEEP_SLEEP=y

# Deep sleep: sensor warm-up then averaged bursts before MQTT (matches Kconfig defaults)
CONFIG_PM_POST_WIFI_SENSOR_WARMUP_SEC=20
CONFIG_PM_POST_WIFI_TRIPLE_COUNT=3

# Default: external U.FL antenna (XIAO ESP32-C6 RF switch)
CONFIG_PM_WIFI_ANT_EXTERNAL=y

# Soil: valid raw window [DISCONNECT_MAX, SPIKE_MIN]; outside → MQTT publishes -1
CONFIG_PM_SOIL_ADC_DISCONNECT_MAX=1300
CONFIG_PM_SOIL_ADC_SPIKE_MIN=3000

# HTTPS device registry URLs (ESP_CONFIG_URL): mbedTLS requires a verification method
CONFIG_MBEDTLS_CERTIFICATE_BUNDLE=y
CONFIG_MBEDTLS_CERTIFICATE_BUNDLE_DEFAULT_FULL=y
```
